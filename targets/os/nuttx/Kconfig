## targets/os/nuttx/Kconfig
```kconfig
#
# For a description of the syntax of this configuration file,
# see the file kconfig-language.txt in the NuttX tools repository.
#

config INTERPRETERS_JJS
	bool "JJS JavaScript engine"
	default n

if INTERPRETERS_JJS

config INTERPRETERS_JJS_PRIORITY
	int "JJS priority"
	default 100

config INTERPRETERS_JJS_STACKSIZE
	int "JJS stack size"
	default 16384

endif # INTERPRETERS_JJS
```
